## Kconfig
```kconfig
mainmenu "NXOS(Next XBook Operating System) Configuration"

config NXOS_ROOT_DIR
    string
    option env="NXOS_ROOT_DIR"
    default "."

config NXOS_SRC_DIR
    string
    option env="NXOS_SRC_DIR"
    default "./src"

source "$NXOS_SRC_DIR/Kconfig"
```

## Src/IO/Kconfig
```kconfig
config IRQ_NAME_LEN
    int "irq name length"
    default 48

config NR_IRQS
    int "irq numbers"
    default 0
    
```

## Src/Init/Kconfig
```kconfig
menu "Debug"
config DEBUG
    bool "Debug NXOS before release"
    default y

if DEBUG
    config LOG_LEVEL
        int "Log level(0: ERROR, 1: WARNING, 2: INFO, 3: DBG)"
        default 3

    config DEBUG_COLOR
        bool "Log output with color"
        default y

    config DEBUG_TIMELINE
        bool "Log output with timeline"
        default y

endif
endmenu

#
# CPU numbers
#
config NR_CPUS
    int "platform CPU numbers"
    default 1
```

## Src/Kconfig
```kconfig
#
# Kconfig for NXOS source code.
#

#
# CPU 64 bits width
#
config NX_CPU_64BITS
    bool 
    default n

menu "OS Kernel"
    #
    # Init
    #
    source "$NXOS_SRC_DIR/Init/Kconfig"

    #
    # IO
    #
    source "$NXOS_SRC_DIR/IO/Kconfig"
    
    #
    # IPC
    #
    source "$NXOS_SRC_DIR/IPC/Kconfig"
    
    #
    # MM
    #
    source "$NXOS_SRC_DIR/MM/Kconfig"

    #
    # Sched
    #
    source "$NXOS_SRC_DIR/Sched/Kconfig"    
endmenu

#
# platfrom select
#
menu "Platform"
    source "$NXOS_SRC_DIR/Platforms/Kconfig"
endmenu

#
# Mods
#
menu "Modules"
    source "$NXOS_SRC_DIR/Mods/Kconfig"
endmenu

#
# Utils
#
menu "Utils"
    source "$NXOS_SRC_DIR/Utils/Kconfig"
endmenu

#
# Tests
#
menu "Tests"
    source "$NXOS_SRC_DIR/Tests/Kconfig"
endmenu
```

## Src/MM/Kconfig
```kconfig
config KVADDR_OFFSET
    hex "kernel virtual address offset to physic address"
    default 0x00000000

config PAGE_SHIFT
    int "page size shift"
    default 12
```

## Src/Mods/Demo/Kconfig
```kconfig
config NX_DEMO_HAL_CONTEXT
    bool "Enable hal context demo for porting platfrom"
    default n
```

## Src/Mods/Kconfig
```kconfig
menu "Console"
    source "$NXOS_SRC_DIR/Mods/Console/Kconfig"
endmenu

menu "Time"
    source "$NXOS_SRC_DIR/Mods/Time/Kconfig"
endmenu

menu "Drivers"
    source "$NXOS_SRC_DIR/Mods/Drivers/Kconfig"
endmenu

menu "Test"
    source "$NXOS_SRC_DIR/Mods/Test/Kconfig"
endmenu

menu "Demo"
    source "$NXOS_SRC_DIR/Mods/Demo/Kconfig"
endmenu
```

## Src/Mods/Test/Kconfig
```kconfig
config NX_ENABLE_TEST_UTEST
    bool "Enable utest test"
    default n

config NX_ENABLE_TEST_INTEGRATION
    bool "Enable integration test"
    default n
```

## Src/Platforms/Amd64/PC64/Kconfig
```kconfig
config PLATFROM_NAME
    string "Platform name"
    default "amd64-PC64"

config PLATFROM_AMD64_PC64
    bool
    default y
    select CPU_64BITS
    
```

## Src/Platforms/Arm32/Qemu/Kconfig
```kconfig
config PLATFROM_NAME
    string "Platform name"
    default "arm32-qemu"

config PLATFROM_ARM32_QEMU
    bool
    default y
    
```

## Src/Platforms/Arm64/Qemu/Kconfig
```kconfig
config NX_PLATFROM_NAME
    string "Platform name"
    default "arm64-qemu"

config PLATFROM_ARM64_QEMU
    bool
    default y
    select NX_CPU_64BITS
    
```

## Src/Platforms/Riscv32/Qemu/Kconfig
```kconfig
config PLATFROM_NAME
    string "Platform name"
    default "riscv32-qemu"

config PLATFROM_RISCV32_QEMU
    bool
    default y
    
```

## Src/Platforms/Riscv64/K210/Kconfig
```kconfig
config PLATFROM_NAME
    string "Platform name"
    default "riscv64-k210"

config PLATFROM_RISCV64_k210
    bool
    default y
    select CPU_64BITS
    
```

## Src/Platforms/Riscv64/Qemu/Kconfig
```kconfig
config PLATFROM_RISCV64_QEMU
    bool
    default y
    select CPU_64BITS

config UART0_FROM_SBI
    bool "Uart0 get/set from SBI"
    default n
```

## Src/Platforms/Riscv64/Qemu/defconfig
```kconfig
CONFIG_CPU_64BITS=y

#
# OS Kernel
#

#
# Debug
#
CONFIG_DEBUG=y
CONFIG_LOG_LEVEL=3
CONFIG_DEBUG_COLOR=y
CONFIG_DEBUG_TIMELINE=y
# end of Debug

CONFIG_PLATFROM_NAME="riscv64-qemu"
CONFIG_NR_MULTI_CORES=4
CONFIG_IRQ_NAME_LEN=48
CONFIG_NR_IRQS=80
CONFIG_KVADDR_OFFSET=0x00000000
CONFIG_PAGE_SHIFT=12
CONFIG_MAX_THREAD_NR=256
CONFIG_THREAD_NAME_LEN=32
CONFIG_THREAD_STACK_SIZE=4096
CONFIG_ENABLE_SCHED=y
# end of OS Kernel

#
# Platform
#
CONFIG_PLATFROM_RISCV64_QEMU=y
CONFIG_UART0_FROM_SBI=y
# end of Platform

#
# Modules
#

#
# Console
#
CONFIG_PRINT_BUF_LEN=256
# end of Console

#
# Time
#
CONFIG_TICKS_PER_SECOND=100
# end of Time

#
# Drivers
#

#
# Test
#
# CONFIG_ENABLE_TEST_UTEST is not set
# CONFIG_ENABLE_TEST_INTEGRATION is not set
# end of Test

#
# Demo
#
CONFIG_DEMO_HAL_CONTEXT=y
# end of Demo
# end of Modules

#
# Utils
#

#
# Tests
#
# end of Tests
```

## Src/Sched/Kconfig
```kconfig
config MAX_THREAD_NR
    int "Max thread numbers"
    default 256

config THREAD_NAME_LEN
    int "thread name length"
    default 32

config THREAD_STACK_SIZE
    int "default thread stack size (bytes)"
    default 4096

config ENABLE_SCHED
    bool "Enable thread scheduler"
    default n
```

## Src/Tests/Integrations/Kconfig
```kconfig
source "$NXOS_SRC_DIR/Tests/Integrations/MM/Kconfig"
source "$NXOS_SRC_DIR/Tests/Integrations/Mods/Kconfig"
source "$NXOS_SRC_DIR/Tests/Integrations/Sched/Kconfig"
source "$NXOS_SRC_DIR/Tests/Integrations/Utils/Kconfig"
source "$NXOS_SRC_DIR/Tests/Integrations/XBook/Kconfig"
```

## Src/Tests/Integrations/MM/Kconfig
```kconfig
config TEST_INTEGRATION_HEAP_CACHE
    bool "Enable integration for heap cache"
    default n

config TEST_INTEGRATION_PAGE
    bool "Enable integration for page"
    default n

config TEST_INTEGRATION_PAGE_HEAP
    bool "Enable integration for page heap"
    default n
```

## Src/Tests/Integrations/Sched/Kconfig
```kconfig
config TEST_INTEGRATION_THREAD
    bool "Enable integration for thread"
    default n

config TEST_INTEGRATION_THREAD_ID
    bool "Enable integration for thread id"
    default n
```

## Src/Tests/Kconfig
```kconfig
menu "Unit test"
    depends on ENABLE_TEST_UTEST
    source "$NXOS_SRC_DIR/Tests/UTests/Kconfig"
endmenu

menu "Integration test"
    depends on ENABLE_TEST_INTEGRATION
    source "$NXOS_SRC_DIR/Tests/Integrations/Kconfig"
endmenu
```

## Src/Tests/UTests/Kconfig
```kconfig
source "$NXOS_SRC_DIR/Tests/UTests/MM/Kconfig"
source "$NXOS_SRC_DIR/Tests/UTests/Mods/Kconfig"
source "$NXOS_SRC_DIR/Tests/UTests/Sched/Kconfig"
source "$NXOS_SRC_DIR/Tests/UTests/Utils/Kconfig"
source "$NXOS_SRC_DIR/Tests/UTests/XBook/Kconfig"
```
