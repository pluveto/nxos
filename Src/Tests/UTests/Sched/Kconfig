## Src/Tests/UTests/Sched/Kconfig
```kconfig
config UTEST_SCHED_MUTEX
    bool "Enable utest for mutex"
    default n

config UTEST_SCHED_SPIN
    bool "Enable utest for spin"
    default n

config UTEST_SCHED_THREAD
    bool "Enable utest for thread"
    default n
```

## src/platforms/amd64/pc64/Kconfig
```kconfig
config NX_PLATFROM_NAME
    string "Platform name"
    default "amd64-PC64"

config PLATFROM_AMD64_PC64
    bool
    default y
    select NX_CPU_64BITS
    
```

## src/platforms/riscv64/k210/Kconfig
```kconfig
config NX_PLATFROM_NAME
    string "Platform name"
    default "riscv64-k210"

config PLATFROM_RISCV64_k210
    bool
    default y
    select NX_CPU_64BITS
    
```

## src/tests/Kconfig
```kconfig
menu "Unit test"
    depends on NX_ENABLE_TEST_UTEST
    source "$NXOS_SRC_DIR/tests/utests/Kconfig"
endmenu

menu "Integration test"
    depends on NX_ENABLE_TEST_INTEGRATION
    source "$NXOS_SRC_DIR/tests/integrations/Kconfig"
endmenu
```

## src/tests/integrations/Kconfig
```kconfig
source "$NXOS_SRC_DIR/tests/integrations/mm/Kconfig"
source "$NXOS_SRC_DIR/tests/integrations/mods/Kconfig"
source "$NXOS_SRC_DIR/tests/integrations/sched/Kconfig"
source "$NXOS_SRC_DIR/tests/integrations/utils/Kconfig"
source "$NXOS_SRC_DIR/tests/integrations/xbook/Kconfig"
```

## src/tests/utests/mods/Kconfig
```kconfig
config NX_UTEST_MODS_UTEST
    bool "Enable utest for utest self"
    default n

config NX_UTEST_MODS_TIMER
    bool "Enable utest for timer"
    default n
```
